#include "Chutchit.dtsi"




&default_transform { 
    col-offset = <10>;
};

&kscan0  {
    col-gpios =
          =  <&gpio0 17 GPIO_ACTIVE_HIGH>,
             <&gpio0 20 GPIO_ACTIVE_HIGH>,
             <&gpio0 22 GPIO_ACTIVE_HIGH>,
             <&gpio0 24 GPIO_ACTIVE_HIGH>,
             <&gpio1 0  GPIO_ACTIVE_HIGH>,  
             <&gpio0 11 GPIO_ACTIVE_HIGH>,
             <&gpio1 4  GPIO_ACTIVE_HIGH>,
             <&gpio1 6  GPIO_ACTIVE_HIGH>,
             <&gpio0 10  GPIO_ACTIVE_HIGH>,
             <&gpio0 9  GPIO_ACTIVE_HIGH>
            ;
};

&encoder_right {
    status = "okay";
};

