## boards/shields/Chutchit/kconfig.shield
```kconfig
# No whitespace after the comma or in your part name!
config SHIELD_CHUTCHIT_LEFT
    def_bool $(shields_list_contains,Chutchit_left)

# No whitespace after the comma or in your part name!
config SHIELD_CHUTCHIT_RIGHT
    def_bool $(shields_list_contains,Chutchit_right)

CONFIG_ZMK_SOFT_OFF=y
```
